## conf/layer.conf
```bitbake
BBPATH .= ":${LAYERDIR}"

BBFILES += "\
            ${LAYERDIR}/recipes-*/*/*.bb \
            ${LAYERDIR}/recipes-*/*/*.bbappend \
           "

BBFILE_COLLECTIONS += "wit-raspi"
BBFILE_PATTERN_wit-raspi := "^${LAYERDIR}/"
BBFILE_PRIORITY_wit-raspi = "7"

# Additional license directories.
LICENSE_PATH += "${LAYERDIR}/licenses"
```
